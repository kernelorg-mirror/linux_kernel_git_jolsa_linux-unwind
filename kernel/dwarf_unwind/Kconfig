## kernel/dwarf_unwind/Kconfig
```kconfig
config DWARF_UNWIND
	bool "Use compiler information to unwind the stack."
	---help---
	  Adding code allowing to use compiled debug data
	  for stack unwinding.

config DWARF_UNWIND_EH_FRAMES
	def_bool DWARF_UNWIND

config DWARF_UNWIND_DEBUGFS
	bool "The debugfs dwarf frames interface."
	depends on DWARF_UNWIND
	---help---
	  The debugfs dwarf frames interface
```
